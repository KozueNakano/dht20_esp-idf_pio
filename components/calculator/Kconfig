## components/calculator/Kconfig
```kconfig
config TEST_DOUBLE
    bool "calculator : enable test double."
    help
        This enables TEST_DOUBLE feature of the calculator component.
```

## components/dht20/Kconfig
```kconfig
menu "DHT20 Configuration"

    config TEST_DOUBLE
        bool "dht20 : enable test double."
        help
            This enables TEST_DOUBLE feature of the calculator component.

    config I2C_MASTER_SCL
        int "SCL GPIO Num"
        default 15
        help
            GPIO number for I2C Master clock line.

    config I2C_MASTER_SDA
        int "SDA GPIO Num"
        default 13
        help
            GPIO number for I2C Master data line.

endmenu
```
